## sdkconfig.defaults
```kconfig
# Matter endpoint count - THE key fix: allow up to 12 endpoints
CONFIG_ESP_MATTER_MAX_DYNAMIC_ENDPOINT_COUNT=12
CONFIG_ESP_MATTER_ENABLE_MATTER=y

# BLE for commissioning
CONFIG_ESP_MATTER_ENABLE_BLE=y
CONFIG_BT_ENABLED=y
CONFIG_BT_BLE_ENABLED=y
CONFIG_BT_BLUEDROID_ENABLED=y
CONFIG_BT_BLE_42_FEATURES_SUPPORTED=y

# Flash
CONFIG_ESPTOOLPY_FLASHSIZE_16MB=y
CONFIG_ESPTOOLPY_FLASHSIZE="16MB"

# Partition table - use custom (3MB app)
CONFIG_PARTITION_TABLE_CUSTOM=y
CONFIG_PARTITION_TABLE_CUSTOM_FILENAME="partitions.csv"

# Logging
CONFIG_LOG_DEFAULT_LEVEL_INFO=y
CONFIG_CHIP_LOG_FILTERING=y

# Bigger main task stack — cJSON recursive print overflows 3.5KB default
CONFIG_ESP_MAIN_TASK_STACK_SIZE=12288
```
